## applications/Light_leg_ws/build/Kconfig/Kconfig.modules
```kconfig
menu "diablo-control (/home/zengjianming/zephyrproject/modules/lib/diablo-control)"
osource "/home/zengjianming/zephyrproject/modules/lib/diablo-control/zephyr/Kconfig"
config ZEPHYR_DIABLO_CONTROL_MODULE
	bool
	default y
endmenu
menu "bmi08x-sensor-api (/home/zengjianming/zephyrproject/modules/lib/bmi08x-sensor-api)"
osource "/home/zengjianming/zephyrproject/modules/lib/bmi08x-sensor-api/zephyr/Kconfig"
config ZEPHYR_BMI08X_SENSOR_API_MODULE
	bool
	default y
endmenu
menu "vl53l5cx-sensor-api (/home/zengjianming/zephyrproject/modules/lib/vl53l5cx-sensor-api)"
osource "/home/zengjianming/zephyrproject/modules/lib/vl53l5cx-sensor-api/zephyr/Kconfig"
config ZEPHYR_VL53L5CX_SENSOR_API_MODULE
	bool
	default y
endmenu
menu "microcdr (/home/zengjianming/zephyrproject/modules/lib/microcdr)"
osource "/home/zengjianming/zephyrproject/modules/lib/microcdr/zephyr/Kconfig"
config ZEPHYR_MICROCDR_MODULE
	bool
	default y
endmenu
menu "diablo-control-a2v2 (/home/zengjianming/zephyrproject/modules/lib/sim-webots)"
osource "/home/zengjianming/zephyrproject/modules/lib/sim-webots/zephyr/Kconfig"
config ZEPHYR_DIABLO_CONTROL_A2V2_MODULE
	bool
	default y
endmenu
menu "hal_nxp (/home/zengjianming/zephyrproject/modules/hal/nxp)"
osource "$(ZEPHYR_HAL_NXP_KCONFIG)"
config ZEPHYR_HAL_NXP_MODULE
	bool
	default y
endmenu
menu "microxrcedds-client (/home/zengjianming/zephyrproject/modules/lib/microxrcedds-client)"
osource "/home/zengjianming/zephyrproject/modules/lib/microxrcedds-client/zephyr/Kconfig"
config ZEPHYR_MICROXRCEDDS_CLIENT_MODULE
	bool
	default y
endmenu
```

## applications/Light_leg_ws/build/Kconfig/Kconfig.shield
```kconfig
osource "/home/zengjianming/zephyrproject/A2_Leg_Light_prj/applications/Light_leg_ws/../..//boards/shields/*/Kconfig.shield"
```

## boards/arm/A2_Light_F103CBT6/A2_Leg_F103CBT6_defconfig
```kconfig
CONFIG_SOC_SERIES_STM32F1X=y
CONFIG_SOC_STM32F103XB=y
# Serial Drivers
CONFIG_SERIAL=y
CONFIG_FPU=y

# enable console
CONFIG_CONSOLE=y

# enable uart driver
CONFIG_RTT_CONSOLE=y
CONFIG_USE_SEGGER_RTT=y

CONFIG_LOG=y
# CONFIG_LOG_MODE_DEFERRED=y
CONFIG_LOG_MODE_IMMEDIATE=y

# GPIO Controller
CONFIG_GPIO=y

CONFIG_PWM=y

CONFIG_CAN=y

CONFIG_SPI=y
# Enables clocks
CONFIG_CLOCK_CONTROL=y

# enable pin controller
CONFIG_PINCTRL=y

# ws2812 led
CONFIG_LED_STRIP=y
CONFIG_LED_STRIP_LOG_LEVEL_DBG=y
CONFIG_WS2812_STRIP=y

CONFIG_RING_BUFFER=y
```

## boards/arm/A2_Light_F103CBT6/Kconfig.board
```kconfig
# Copyright 2021 The Chromium OS Authors
# SPDX-License-Identifier: Apache-2.0

config BOARD_DIRECTDRIVETECH_A2_Leg_F103CBT6
	bool "DirectDriveTech A2 Leg F103CBT6"
	depends on SOC_STM32F103CXT6
```

## boards/arm/A2_Light_F103CBT6/Kconfig.defconfig
```kconfig
# Copyright 2021 The Chromium OS Authors
# SPDX-License-Identifier: Apache-2.0

if BOARD_DIRECTDRIVETECH_A2_Leg_F103CBT6

config BOARD
	default "A2_Leg_F103CBT6"

config SPI_STM32_INTERRUPT
	default y
	depends on SPI

endif # BOARD_DIRECTDRIVETECH_A2_Leg_F103CBT6
```
